## configs/rockchip_rk3328_hid3_defconfig
```kconfig
#include "rk3328_arm64.config"
#include "base.config"
#include "base_extra.config"
#include "debug.config"
BR2_PACKAGE_HID3MTOUCH=y
BR2_ROOTFS_OVERLAY="board/rockchip/rk3328/fs-overlay-64/ ../app/SiBeamHID3/buildroot_overlay"
BR2_TARGET_GENERIC_HOSTNAME="rk3328"
BR2_TARGET_GENERIC_ISSUE="Welcome to HoverCam SiBeamHID3"
```

## configs/rockchip_rk3328_ws8_defconfig
```kconfig
#include "rk3328_arm64.config"
#include "base.config"
#include "base_extra.config"
#include "debug.config"

BR2_ROOTFS_OVERLAY="board/rockchip/rk3328/fs-overlay-64/"
BR2_TARGET_GENERIC_HOSTNAME="rk3328"
BR2_TARGET_GENERIC_ISSUE="Welcome to HoverCam Wireless Solo8"
BR2_TARGET_ROOTFS_EXT2_SIZE="200M"
```

## package/hovercam/hid3mtouch/Config.in
```kconfig
config BR2_PACKAGE_HID3MTOUCH
        bool "hid3mtouch"
        help
          This package is the hid3mtouch application for the SiBeamHID3 image.

          https://github.com/thehovercam/SiBeamHID3.git
```
